/* Raspberry Pi 5: switches on all 4 hardware PWM outputs
   GPIO12 (ch0), GPIO13 (ch1), GPIO18 (ch2), GPIO19 (ch3).
   Based on Gadgetoid's published Pi 5 overlay. Installed by setup_pwm.sh */
/dts-v1/;
/plugin/;

/{
	compatible = "brcm,bcm2712";

	fragment@0 {
		target = <&rp1_gpio>;
		__overlay__ {
			pwm_pins: pwm_pins {
				pins = "gpio12", "gpio13", "gpio18", "gpio19";
				function = "pwm0", "pwm0", "pwm0", "pwm0";
			};
		};
	};

	fragment@1 {
		target = <&rp1_pwm0>;
		frag1: __overlay__ {
			pinctrl-names = "default";
			pinctrl-0 = <&pwm_pins>;
			status = "okay";
		};
	};
};
